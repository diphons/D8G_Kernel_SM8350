## drivers/staging/cam-reclaim/Kconfig
```kconfig
config CAM_RECLAIM
	bool "reclaim pages under camera condition"
	default y
	depends on MIUI_OPTIMIZATIONS
```

## drivers/staging/mi-reclaim/Kconfig
```kconfig
config MI_RECLAIM
	bool "reclaim pages"
	default y
	depends on MIUI_OPTIMIZATIONS
```
